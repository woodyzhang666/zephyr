## boards/arm/ch32f103c8_mini/Kconfig.board
```kconfig
# SPDX-License-Identifier: Apache-2.0

config BOARD_CH32F103C8_MINI
	bool "CH32F103C8 Mini Board"
	depends on SOC_CH32F103X8
```

## boards/arm/ch32f103c8_mini/Kconfig.defconfig
```kconfig
# SPDX-License-Identifier: Apache-2.0

if BOARD_CH32F103C8_MINI

config BOARD
	default "ch32f103c8_mini"

endif
```

## boards/arm/ch32f103c8_mini/ch32f103c8_mini_defconfig
```kconfig
# SPDX-License-Identifier: Apache-2.0

CONFIG_SOC_SERIES_CH32FX=y
CONFIG_SOC_CH32F103X8=y

# enable uart driver
CONFIG_SERIAL=y
# enable console
CONFIG_CONSOLE=y
CONFIG_UART_CONSOLE=y

# enable GPIO
CONFIG_GPIO=y

# enable clocks
CONFIG_CLOCK_CONTROL=y
CONFIG_CLOCK_STM32_RCC=y

# enable pin controller
CONFIG_PINCTRL=y
```

## drivers/clock_control/Kconfig.wch
```kconfig
config CLOCK_CONTROL_WCH
	bool "WCH Clock driver"
	depends on SYSCON_CH57X
	default y
	help
	  Enable support for WCH clock driver.

if CLOCK_CONTROL_WCH

DT_WCH_HSE_CLOCK := $(dt_nodelabel_path,clk_hse)
DT_WCH_HSE_CLOCK_FREQ := $(dt_node_int_prop_int,$(DT_WCH_HSE_CLOCK),clock-frequency)

config CLOCK_WCH_HSE_CLOCK
	int "hse clock value"
	default "$(DT_WCH_HSE_CLOCK_FREQ)" if "$(dt_nodelabel_enabled,clk_hse)"
	default 32000000
	help
	  Value of external high-speed clock (HSE). This symbol could be optionally
	  configured using device tree by setting "clock-frequency" value of clk_hse
	  node. For instance:
	  &clk_hse{
	  status = "okay";
	  clock-frequency = <DT_FREQ_M(25)>;
	  };
	  Note: Device tree configuration is overridden when current symbol is set:
	  CONFIG_CLOCK_WCH_HSE_CLOCK=32000000

endif
```

## drivers/gpio/Kconfig.wch
```kconfig
config GPIO_WCH
	bool "WCH GPIO"
	depends on SYSCON_CH57X
	default y
	help
	  Enables the WCH GPIO driver
```

## drivers/interrupt_controller/Kconfig.pfic
```kconfig
DT_COMPAT_WCH_PFIC = wch,wch-pfic

config HAS_WCH_PFIC
	bool
	help
	  Indicate that the platform has PFIC.

config WCH_PFIC
	bool "Programmable Fast Interrupt Controller (PFIC)"
	default $(dt_compat_enabled,$(DT_COMPAT_WCH_PFIC))
	depends on HAS_WCH_PFIC
	help
	  Interrupt controller for Nuclei SoC core.
```

## drivers/serial/Kconfig.wch_uart
```kconfig
DT_COMPAT_WCH_UART := wch,wch-uart

config UART_WCH
	bool "WCH UART"
	default $(dt_compat_enabled,$(DT_COMPAT_WCH_UART))
	select SERIAL_HAS_DRIVER
	select SERIAL_SUPPORT_INTERRUPT
	help
	  This option enables the UART driver for many wch SOCs.
```

## drivers/timer/Kconfig.ch57x_sys
```kconfig
DT_COMPAT_WCH_CH57X_SYSTICK := wch,ch57x-systick

config CH57X_SYSTICK
	bool "ch57x SYSTICK timer"
	depends on SOC_SERIES_CH57X
	default $(dt_compat_enabled,$(DT_COMPAT_WCH_CH57X_SYSTICK))
	select TICKLESS_CAPABLE
	select SYSTEM_TIMER_HAS_DISABLE_SUPPORT
	help
	  This option enables count-down systick timer on ch57x series.

DT_COMPAT_WCH_CH58X_SYSTICK := wch,ch58x-systick

config CH58X_SYSTICK
	bool "ch58x SYSTICK timer"
	depends on SOC_SERIES_CH57X
	default $(dt_compat_enabled,$(DT_COMPAT_WCH_CH58X_SYSTICK))
	select TICKLESS_CAPABLE
	select SYSTEM_TIMER_HAS_DISABLE_SUPPORT
	help
	  This option enables count-down systick timer on ch58x series.
```

## drivers/timer/Kconfig.wch_systick
```kconfig
DT_COMPAT_WCH_SYSTICK := wch,wch-systick

config WCH_SYSTICK
	bool "WCH SYSTICK timer"
	depends on CPU_HAS_WCH_SYSTICK
	default $(dt_compat_enabled,$(DT_COMPAT_WCH_SYSTICK)) 
	select TICKLESS_CAPABLE
	select SYSTEM_TIMER_HAS_DISABLE_SUPPORT
	help
	  This module implements a kernel device driver for the SYSTICK timer in
	  WCH RISV-C processors and provides the standard "system clock driver"
	  interfaces.
```

## dts/bindings/clock/wch,ch57x-pll-clock.yaml
```yaml
description: |
  Take hse as input source, with a fixed mul of 15 (vendor does not recomend to
  modify the register).

compatible: "wch,ch57x-pll-clock"

include: [clock-controller.yaml, base.yaml]

properties:
    "#clock-cells":
      const: 0

    clocks:
      required: true

    mul:
      type: int
      required: true
      description: |
          Main PLL multiplication factor for VCO
          Valid range: 2 - 16

    usbpre:
      type: int
      required: false
      description: |
          PLL divisor for usb clock
```

## dts/bindings/clock/wch,ch57x-rcc.yaml
```yaml
description: |
  CH57X Clock controller
  This node is in charge of system clock source selection and controlling
  clocks for periphrals.

  System clock source should be selected amongst the clock nodes available in
  "clocks" node (one of "clk_hse", "clk_pll", "clk_ck32k").
  Core clock frequency should also be defined, using "clock-frequency" property
  if the source is pll because a prescaler from pll or hse is supported.

compatible: "wch,ch57x-rcc"

include: [clock-controller.yaml, base.yaml]

properties:
    reg:
      required: false

    "#clock-cells":
      const: 1

    clock-frequency:
      required: true
      type: int
      description: |
        default frequency in Hz for clock output

clock-cells:
  - bits
```

## dts/bindings/gpio/wch,wch-gpio.yaml
```yaml
description: WCH GPIO node

compatible: "wch,wch-gpio"

include: [gpio-controller.yaml, base.yaml]

properties:
    reg:
      required: false

    label:
      required: false

    clocks:
      required: false

    pin-mask:
      type: int
      required: true
      description: |
          Mask of existing pins. Their numbers are not contiguous and ngpios
          can't describe them.

    "#gpio-cells":
      const: 2

gpio-cells:
  - pin
  - flags
```

## dts/bindings/interrupt-controller/riscv,pfic.yaml
```yaml
description: WCH RISCV PFIC

compatible: "riscv,pfic"

include: [interrupt-controller.yaml, base.yaml]

properties:
  reg:
      required: true

  num-irq-priority-bits:
      required: true
      type: int
      description: number of bits of IRQ priorities

  "#interrupt-cells":
      const: 2

interrupt-cells:
  - irq
  - priority
```

## dts/bindings/interrupt-controller/wch,wch-pfic.yaml
```yaml
description: WCH Programmable Fast Interrupt Controller
compatible: "wch,wch-pfic"

include: [interrupt-controller.yaml, base.yaml]

properties:
  reg:
      required: true

interrupt-cells:
  - irq
  - priority
```

## dts/bindings/usb/wch,wch-usbhd.yaml
```yaml
description: WCH USB controller

compatible: "wch,wch-usbhd"

include: [usb-ep.yaml, pinctrl-device.yaml]

properties:
    reg:
      required: true

    interrupts:
      required: true

    clocks:
      required: true
```

## soc/arm/wch/Kconfig
```kconfig
# SPDX-License-Identifier: Apache-2.0

config SOC_FAMILY_WCH_ARM
	bool
	select BUILD_OUTPUT_HEX

if SOC_FAMILY_WCH_ARM

config SOC_FAMILY
	string
	default "wch"

source "soc/arm/wch/*/Kconfig.soc"

endif
```

## soc/arm/wch/Kconfig.defconfig
```kconfig
# SPDX-License-Identifier: Apache-2.0

source "soc/arm/wch/*/Kconfig.defconfig.series"
```

## soc/arm/wch/ch32f/Kconfig.defconfig.ch32f103xx
```kconfig
# SPDX-License-Identifier: Apache-2.0

if SOC_CH32F103X8 || SOC_CH32F103X6

config SOC
	default "ch32f103x8"

config NUM_IRQS
	default 44

endif
```

## soc/arm/wch/ch32f/Kconfig.defconfig.series
```kconfig
# SPDX-License-Identifier: Apache-2.0

if SOC_SERIES_CH32FX

source "soc/arm/st_stm32/ch32f/Kconfig.defconfig.ch32f*"

config SOC_SERIES
	default "ch32f"

endif
```
