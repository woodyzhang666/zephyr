## soc/arm/wch/ch32f/Kconfig.series
```kconfig
# SPDX-License-Identifier: Apache-2.0
#
config SOC_SERIES_CH32FX
	bool "CH32Fx Series MCU"
	select ARM
	select CPU_CORTEX_M3
	select CPU_CORTEX_M_HAS_DWT
	select SOC_FAMILY_WCH_ARM
	select HAS_SWO
	help
	  Enable support for CH32Fx MCU series
```

## soc/arm/wch/ch32f/Kconfig.soc
```kconfig
# SPDX-License-Identifier: Apache-2.0

choice
	prompt "CH32Fx MCU Selection"
	depends on SOC_SERIES_CH32FX

config SOC_CH32F103X8
	bool "CH32F103X8"

config SOC_CH32F103X6
	bool "CH32F103X6"

config SOC_CH32F203X6
	bool "CH32F203X6"

config SOC_CH32F203X8
	bool "CH32F203X8"

config SOC_CH32F203XB
	bool "CH32F203XB"

config SOC_CH32F203XC
	bool "CH32F203XC"

config SOC_CH32F205RB
	bool "CH32F205RB"

config SOC_CH32F207VC
	bool "CH32F207VC"

config SOC_CH32F208XB
	bool "CH32F208XB"

endchoice
```

## soc/riscv/wch/Kconfig
```kconfig
config SOC_FAMILY_WCH_RISCV
	bool

if SOC_FAMILY_WCH_RISCV

config SOC_FAMILY
	string
	default "wch"

source "soc/riscv/wch/*/Kconfig.soc"

endif  # SOC_FAMILY_WCH_RISCV
```

## soc/riscv/wch/ch57x/Kconfig.defconfig.series
```kconfig
if SOC_SERIES_CH57X

config SOC_SERIES
	default "ch57x"

DT_WCH_RCC:= $(dt_nodelabel_path,rcc)
DT_WCH_SYSCLK_FREQ := $(dt_node_int_prop_int,$(DT_WCH_RCC),clock-frequency)

config SYS_CLOCK_HW_CYCLES_PER_SEC
	default $(DT_WCH_SYSCLK_FREQ)

config MAIN_STACK_SIZE
	default 1024

config SYSCON_INIT_PRIORITY
	default 10

if SOC_CH573F

config SOC
	default "ch573f"

config NUM_IRQS
	default 36

endif

endif
```

## soc/riscv/wch/ch57x/Kconfig.series
```kconfig
config SOC_SERIES_CH57X
	bool "CH57X Series MCU"
	select RISCV
	select SOC_FAMILY_WCH_RISCV
	select XIP
	select RISCV_ISA_RV32I
	select RISCV_ISA_EXT_M
	select RISCV_ISA_EXT_A
	select RISCV_ISA_EXT_C
	select SYSCON
	help
		Enable support for ch571, ch573.
```

## soc/riscv/wch/ch57x/Kconfig.soc
```kconfig
choice
	prompt "CH57X MCU Selection"
	depends on SOC_SERIES_CH57X

config SOC_CH573F
	bool "CH573F"

config SOC_CH582M
	bool "CH582M"

endchoice
```

## subsys/debugger/Kconfig
```kconfig
menuconfig DEBUGGER_ADAPTER
	bool "debugger adapter"
	help
	  This option enables building zephyr as a debugger firmware.

if DEBUGGER

module = DEBUGGER
module-str = debugger
source "subsys/logging/Kconfig.template.log_config"


choice DEBUGGER_ADAPTER_TYPE
	prompt "Debugger Adapter Type Selection"
	default DAPLINK
	help
	  Select the Debugger Adapter type.

config DAPLINK
    bool "Daplink"
    help
      Arm CMSIS DAP v2, i.e. Daplink.

endchoice

if DAPLINK

config DAPLINK_SWD
    bool "Enable SWD Support"
    help
      Enable SWD Support on Daplink Instances

config DAPLINK_JTAG
    bool "Enable JTAG Support"
    help
      Enable JTAG Support

config DAPLINK_JTAG_DEV_CNT
    int "Max devices on JTAG chain"
    default 4
    help
      Max devices on JTAG chain

config DAPLINK_DEFAULT_PORT
    int "Default Target Port"
    default 1
    help
      Default Target Port after initialization,  1: SWD, 2: JTAG.

config CPU_FREQ
    int "CPU frequency"
    help
      CPU frequency.

config IO_PORT_WRITE_CYCLES
    int "CPU Cycles needed for an IO write operation"
    default 2
    help
      CPU Cycles needed for an IO write operation. Used to calculate delay
      time.

config DAPLINK_DEFAULT_SWJ_CLOCK_FREQ
    int "Default SWD/JTAG Clock Frequency"
    default 1000000
    help
        Default SWD/JTAG Clock Frequency. Limited by GPIO frequency.

config DAPLINK_PACKET_SIZE
    int "Command/Response Packet Size"
    default 512
    help
      Command/Response Packet Size

config DAPLINK_PACKET_COUNT
    int "Response Packet Buffer Count"
    default 4
    help
      Response Packet Buffer Count

config DAPLINK_SWO_UART
    bool "Enable SWO UART"

config DAPLINK_SWO_BUFFER_SIZE
    int "SWO Buffer Size"
    default 4096

config DAPLINK_SWO_STREAM_TRACE
    bool "Enable SWO Stream Trace"

config DAPLINK_UART
    bool "Enable Daplink UART"


endif # DAPLINK

config DEBUGGER_CRB_BUF_SIZE
    int "Size of Command Response Buffer"
    default 128
    help
      Size of Command Response Buffer

source "subsys/debugger/transport/Kconfig"

choice DEBUGGER_TARGET_DRIVER
    prompt "Type of connection between debugger and target"
    default DEBUGGER_TARGET_DRIVER_GPIO_BITBANG
    help
      Select the debugger target driver

config DEBUGGER_TARGET_DRIVER_GPIO_BITBANG
    bool "Emulate JTAG/SWD sequences using GPIO BitBang"
    help
      Emulate JTAG/SWD sequences using GPIO BitBang

endchoice

endif # DEBUGGER_ADAPTER
```

## subsys/debugger/transport/Kconfig
```kconfig
choice DEBUGGER_TRANSPORT
    prompt "Debugger Transport type"
    default DEBUGGER_TRANSPORT_USB
    help
      Select the transport type of debugger

config DEBUGGER_TRANSPORT_USB
    bool "Debugger Transport Over USB"
    help
      The Debugger communicates with host through USB.

config DEBUGGER_TRANSPORT_ETH
    bool "Debugger Transport Over Ethernet"
    help
      The Debugger communicates with host through Ethernet.

endchoice

config DEBUGGER_USB_EP_MPS
    int "Max Packet Size of Bulk Endpoints"
    default 64
    help
        Max Packet Size of Bulk Endpoints of the Debugger Interface
```
